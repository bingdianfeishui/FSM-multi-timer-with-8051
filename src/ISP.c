/******************************************************************************
* 文    件: ISP.c
* 原作者: 李锋源
* 修  改: ZhnJa
* 创建日期: 2011-7-15
* 修改日期: 2013-8-01
* 说 明: 原文件为阿土开发板的Driver.c，提取出来的ISP下载程序。
******************************************************************************/

#include "ISP.h"


#ifdef	Self_Define_ISP_Download			//如果有自定义ISP下载功能
UINT8 bufptr;
code UINT8 passward[] = {ICPCODE};
UINT8 buf[sizeof(passward) * 2];		//静态串口缓冲区
#endif

/******************************************************************************
*                               UART初始化
*描    述：串口初始化函数， 通常是在使用串口前调用本函数来进行初始化， 通常是在
*          main函数中调用。
*入口参数：无
*返    回：无
*注    意：串口使用的是中断模式
******************************************************************************/
void UARTInit(void)
{

	UINT8 i;
	UINT16 j;
#ifdef	Self_Define_ISP_Download   //自定义下载使用到
	bufptr = 0;
	for ( i = 0; i < sizeof(buf); i++)
	{
		buf[i] = 0;
	}
#endif
	EA = 0; 							//暂时关闭中断
	TMOD &= 0x0F;
	TMOD |= 0x20;    				//定时器1工作在模式2，自动重装模式
	SCON = 0x50;     					//串口工作在模式1
	TH1 = 256 - TH1_NUM; //计算定时器重装值
	TL1 = TH1;
	PCON |= 0x80;    					//串口波特率加倍
	// ES = 1;         				//串行中断允许
	TR1 = 1;        					//启动定时器1
	REN = 1;        					//允许接收
	EA = 1;         					//允许中断

	for (i = 0; i < 8; i++)			 	//短暂延时判断有无ISP下载命令
	{
		for (j = 0; j < 40000; j++)
		{
			if (RI)
			{
				RI = 0;
				IAP_CONTR = 0x60;	 //复位到IAP
			}
		}
	}
	ES = 1;         					//串行中断允许
}


/******************************************************************************
*                               延时1s函数
*描    述：延时1s函数，在UartInit()调用供ISP延时。
*入口参数：无
*返    回：无
*注    意：
******************************************************************************/
void delay1s(void)
{
	UINT8 i, j, k;
	for (i = 0; i < 200; i++)
	{
		for (j = 0; j < 200; j++)
		{
			k = 10;
			while (k--);
		}
	}
}
/******************************************************************************
*                           发送一个字符
*描    述：向串口发送一个字符。
*入口参数：要发送的字符
*返    回：无
*注    意：
******************************************************************************/
void SendByte(UINT8 c)
{
	SBUF = c;
	while (!TI);
	TI = 0;
}
/******************************************************************************
*                          发送一个字符串
*描    述：向串口发送一个字符串
*入口参数：*s要发送的字符串
*返    回：无
*注    意：
******************************************************************************/
void SendStr(char *s)
{
	while (*s)
	{
		SendByte(*s++);
	}
}

/******************************************************************************
*                               串口0中断
*描    述：串口0（UART0)中断。
*入口参数：无
*返    回：无
*注    意：
******************************************************************************/
void UartISR(void) interrupt 4
{
#ifdef Self_Define_ISP_Download

	UINT8 ptScr, ptDst;
	if (RI)
	{
		RI = 0;				//清标志位
		buf[bufptr] = SBUF;
		ptScr = bufptr;
		if (bufptr == sizeof(buf))
		{
			bufptr = 0;
		}
		else
		{
			bufptr++;
		}
		while (buf[ptScr] == passward[ptDst])
		{
			if (ptScr == 0)
			{
				ptScr = sizeof(buf) - 1;
			}
			else
			{
				ptScr--;
			}
			if (ptDst == 0)
			{
				//	reset();
				delay1s();
				//复位前提示程序
				IAP_CONTR = 0x60;	 	//复位到IAP
			}
			else
			{
				ptDst--;
			}
		}
		//用户程序开始


		//用户程序结束
	}//End if(RI)
	if (TI)							//发送完成
	{
		TI = 0;						//清标志位
	}
#else		   						//如果不使用自定义ISP下载程序
	if (RI)
	{
		RI = 0;
	}
	else
	{
		TI = 0;
	}
#endif
}

/*======================End Of File====================*/
